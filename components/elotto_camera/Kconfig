## components/elotto_camera/Kconfig
```kconfig
menu "Elotto Camera (OV5647 dark-frame entropy)"

    config ELOTTO_CAM_ENABLE
        bool "Enable OV5647 camera entropy"
        default n
        help
            Shared by the master (elotto) and slave (elotto_slave) firmwares --
            the slave reaches this component through
            EXTRA_COMPONENT_DIRS=../elotto/components, so both nodes run byte
            identical extraction code. Also requires, under Component config:
            - Espressif Camera Sensors Configurations -> OV5647 (CAMERA_OV5647=y)
            - Espressif Video Configuration -> Enable MIPI-CSI based Video Device
              (on by default for esp32p4)
            The pin defaults below match Espressif's own ESP32-P4-Function-EV-Board
            reference design (1.0mm-pitch 15-pin FPC MIPI-CSI connector, same
            connector class as a standard Raspberry-Pi-style OV5647 module) --
            verify against your actual board before trusting them on hardware
            this project hasn't seen.

    if ELOTTO_CAM_ENABLE

        config ELOTTO_CAM_XCLK_PIN
            int "XCLK output pin (SoC clock router -> sensor XCLK input)"
            default -1
            help
                GPIO driving the OV5647's external clock input via the P4's
                built-in clock router. Default -1 (disabled) matches Espressif's
                Function-EV-Board reference for its 15-pin MIPI-CSI connector --
                standard RPi-style OV5647 camera boards carry their own crystal,
                so the host doesn't drive XCLK. If the camera never reports a
                chip ID in the boot log, this is the first thing to revisit
                (try the board's other camera header XCLK pin, e.g. GPIO20 on
                the Function-EV-Board's DVP/SPI headers, as a fallback).

        config ELOTTO_CAM_XCLK_FREQ
            int "XCLK frequency (Hz)"
            default 24000000
            help
                The OV5647 MIPI formats in esp_cam_sensor are characterized for a
                24 MHz input clock (see "24M input" in the format names) -- do not
                change unless you also re-check the sensor's PLL settings.

        config ELOTTO_CAM_SCCB_I2C_PORT
            int "SCCB(I2C) port number"
            default 0

        config ELOTTO_CAM_SCCB_I2C_FREQ
            int "SCCB(I2C) frequency (Hz)"
            default 100000
            range 100000 400000

        config ELOTTO_CAM_SCL_PIN
            int "SCCB(I2C) SCL pin"
            default 8
            help
                GPIO8 matches Espressif's Function-EV-Board reference (both v1.4
                and v1.5) for the 15-pin MIPI-CSI FPC connector. Verify against
                your actual board.

        config ELOTTO_CAM_SDA_PIN
            int "SCCB(I2C) SDA pin"
            default 7
            help
                GPIO7 matches Espressif's Function-EV-Board reference (both v1.4
                and v1.5) for the 15-pin MIPI-CSI FPC connector. Verify against
                your actual board.

        config ELOTTO_CAM_RESET_PIN
            int "Reset pin (-1 if not wired)"
            default -1
            help
                -1 matches the reference board default. The standard 15-pin RPi
                CSI cable pinout has no dedicated reset line, so this is expected
                to stay unwired.

        config ELOTTO_CAM_PWDN_PIN
            int "Power-down pin (-1 if not wired)"
            default -1
            help
                -1 matches the reference board default. The standard 15-pin RPi
                CSI cable pinout has no dedicated power-down line, so this is
                expected to stay unwired.

        config ELOTTO_CAM_XOR_FOLD
            bool "XOR-fold the extracted bits (halves rate, squares the bias)"
            default y
            help
                Emit one bit per pixel *pair* as LSB(i) XOR LSB(i+1) instead of
                one bit per pixel. Standard debiasing: a bias e becomes ~2e^2,
                so the measured 0.0151 lands near 5e-4. It also collapses the
                per-mini-run sigma overdispersion, since that is driven by the
                same varying bias.

                It costs half the pre-fold throughput, and that cost is already
                paid: the 5.71 Mbit/s per node this array runs at IS the folded
                rate. Do not read the number as raw and halve it again.

                Leave it on. The fold is permanently enabled by decision -- there
                is no fold trial in the sweep, and turning it off produces a
                stream this project will not measure.

                It masks the bias rather than removing its cause (likely ISP
                digital processing making the raw LSB non-uniform). The raw,
                pre-fold bias stays visible in /diag either way, so investigating
                the cause never requires turning the fold off.

        config ELOTTO_CAM_REG_EXPOSURE
            int "Fixed exposure (OV5647 reg 0x3500-0x3502, row-time units, 20-bit)"
            default 16
            range 1 1048575
            help
                Written directly to the sensor (bypassing the driver's high-level
                "AE target" control, which doesn't disable the auto-exposure loop)
                right after manual mode is forced via reg 0x3503.

                ⚠ This is only the BOOT value. Every node sweeps its exposure
                ladder at each block and keeps the rung it certifies -- 32/64/128
                on this rig, different per node on purpose. Nothing runs at this
                number for longer than the first sweep, so changing it moves the
                starting point and nothing else. POST /expose sets an operating
                point by hand for tuning the physical light; the next sweep
                overwrites that too.

        config ELOTTO_CAM_REG_GAIN
            int "Fixed analog gain (OV5647 reg 0x350a-0x350b, 10-bit)"
            default 1023
            range 0 1023
            help
                Written directly to the sensor after forcing AGC manual mode
                (reg 0x3503). Defaults to max: amplifies read noise above the ADC
                quantization floor. Like the exposure above, the sweep owns this
                at run time -- it is the boot value, not the operating point.

    endif

endmenu
```
